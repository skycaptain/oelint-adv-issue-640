## meta-oelint-adv-issue-640/conf/layer.conf
```bitbake
# We have a conf and classes directory, add to BBPATH
BBPATH .= ":${LAYERDIR}"

# We have recipes-* directories, add to BBFILES
BBFILES += "\
    ${LAYERDIR}/recipes-*/*/*.bb \
    ${LAYERDIR}/recipes-*/*/*.bbappend \
    "

BBFILE_COLLECTIONS += "oelint-adv-issue-640"
BBFILE_PATTERN_oelint-adv-issue-640 = "^${LAYERDIR}/"
BBFILE_PRIORITY_oelint-adv-issue-640 = "50"

LAYERDEPENDS_oelint-adv-issue-640 = "\
    core \
    "

LAYERSERIES_COMPAT_oelint-adv-issue-640 = "scarthgap"

# This should only be incremented on significant changes that will cause compatibility issues with
# other layers
LAYERVERSION_oelint-adv-issue-640 = "1"

BBFILES_DYNAMIC += "\
    clang-layer:${LAYERDIR}/dynamic-layers/clang-layer/recipes-*/*/*.bb \
    clang-layer:${LAYERDIR}/dynamic-layers/clang-layer/recipes-*/*/*.bbappend \
    "

LAYERRECOMMENDS_oelint-adv-issue-640 = "\
    clang-layer \
    "
```
